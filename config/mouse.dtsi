// Settings tuned for 3840 x 2160 display resolution
#define ZMK_POINTING_DEFAULT_MOVE_VAL 1500 // 600
#define ZMK_POINTING_DEFAULT_SCRL_VAL 120  // 10

#include <dt-bindings/zmk/pointing.h>

// Config from @caksoylar, defaults in comments
&mmv {
    time-to-max-speed-ms = <680>;
    acceleration-exponent = <2>;
};

&msc {
    time-to-max-speed-ms = <500>;                 /* <--- How long time until max speed is reached */
};

#define U_MS_U &mmv MOVE_UP
#define U_MS_D &mmv MOVE_DOWN
#define U_MS_L &mmv MOVE_LEFT
#define U_MS_R &mmv MOVE_RIGHT
#define U_WH_U &msc SCRL_UP
#define U_WH_D &msc SCRL_DOWN
#define U_WH_L &msc SCRL_LEFT
#define U_WH_R &msc SCRL_RIGHT
