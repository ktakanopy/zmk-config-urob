#include <behaviors.dtsi>
#include <dt-bindings/zmk/keys.h>

#include <dt-bindings/zmk/bt.h>
#include <dt-bindings/zmk/outputs.h>
#define _BT_SEL_KEYS_ &bt BT_SEL 0 &bt BT_SEL 1 &bt BT_SEL 2 &bt BT_SEL 3 &bt BT_CLR
#include "zmk-helpers/helper.h"
#include "zmk-helpers/unicode-chars/greek.dtsi"
#include "zmk-helpers/unicode-chars/german.dtsi"

#define DEF 0
#define NUM 1
#define NAV 2
#define FUN 3
#define NAV2 4
#define XXX &none
#define ___ &trans

/* Global settings */

#define QUICK_TAP_MS 175

&sk {  // sticky-key config
    release-after-ms = <1500>; // release after 1.5s
    quick-release;             // no double capitalization when rolling keys
};

&sl {  // sticky-layer config
    ignore-modifiers;          // allow chording sticky mods & layers
};

&lt {  // layer-tap config
    flavor = "balanced";
    tapping-term-ms = <200>;
    quick-tap-ms = <QUICK_TAP_MS>;
};

/* Homerow mods */

#define KEYS_L LT0 LT1 LT2 LT3 LT4 LM0 LM1 LM2 LM3 LM4 LB0 LB1 LB2 LB3 LB4  // left hand
#define KEYS_R RT0 RT1 RT2 RT3 RT4 RM0 RM1 RM2 RM3 RM4 RB0 RB1 RB2 RB3 RB4  // right hand
#ifndef LH2
    #define THUMBS LH1 LH0 RH0 RH1                                          // thumbs on 34 keys
#else
    #define THUMBS LH2 LH1 LH0 RH0 RH1 RH2                                  // thumbs on 36+ keys
#endif

#define MAKE_HRM(NAME, HOLD, TAP, TRIGGER_POS) \
    ZMK_HOLD_TAP(NAME, \
        flavor = "balanced"; \
        tapping-term-ms = <200>; \
        quick-tap-ms = <QUICK_TAP_MS>; \
        require-prior-idle-ms = <150>; \
        bindings = <HOLD>, <TAP>; \
        hold-trigger-key-positions = <TRIGGER_POS>; \
        hold-trigger-on-release; \
    )
MAKE_HRM(hml, &kp, &kp, KEYS_R THUMBS)  // left-hand HRMs
MAKE_HRM(hmr, &kp, &kp, KEYS_L THUMBS)  // right-hand HRMs

// HRM combo hack - workaround for lack of tap-only combos (ZMK issue #544)
#define ZMK_COMBO_8(NAME, TAP, KEYPOS, LAYERS, COMBO_TERM, COMBO_IDLE, HOLD, SIDE) \
    MAKE_HRM(hm_combo_ ## NAME, &kp, TAP, SIDE THUMBS) \
    ZMK_COMBO_6(NAME, &hm_combo_ ## NAME HOLD 0, KEYPOS, LAYERS, COMBO_TERM, COMBO_IDLE)

/* Combos and leader key sequences */

#include "combos.dtsi"  // must be sources after HRM-combo hack
#include "leader.dtsi"
#include "mouse.dtsi"
#include "extra_keys.h"

/* vim: set ft=c tw=174: */

/* Custom behaviors */

// Alt+Tab swapper, requires PR #1366
ZMK_TRI_STATE(swapper,
    bindings = <&kt LALT>, <&kp TAB>, <&kt LALT>;
)

ZMK_TRI_STATE(cmd_swapper,
    bindings = <&kt LGUI>, <&kp TAB>, <&kt LGUI>;
    timeout-ms = <1000>;
)

ZMK_TAP_DANCE(alt_caps,
    tapping-term-ms = <200>;
    bindings = <&kp LALT>, <&kp CAPS>;
)

ZMK_TAP_DANCE(shift_caps_word,
    tapping-term-ms = <200>;
    bindings = <&sk LSHFT>, <&caps_word>;
)

ZMK_HOLD_TAP(fst_lt,
    flavor = "balanced";
    tapping-term-ms = <200>;
    quick-tap-ms = <120>;
    bindings = <&kp>, <&kp>;
)

ZMK_HOLD_TAP(thumb_lt,
    flavor = "balanced";
    tapping-term-ms = <200>;
    quick-tap-ms = <QUICK_TAP_MS>;
    require-prior-idle-ms = <150>;
    bindings = <&mo>, <&kp>;
)

ZMK_MACRO(tmux_prev_window,
    wait-ms = <10>;
    tap-ms = <10>;
    bindings = <&macro_tap &kp LC(SPACE) &kp P>;
)

ZMK_MACRO(tmux_next_window,
    wait-ms = <10>;
    tap-ms = <10>;
    bindings = <&macro_tap &kp LC(SPACE) &kp LS(N)>;
)

ZMK_MACRO(tmux_last_window,
    wait-ms = <10>;
    tap-ms = <10>;
    bindings = <&macro_tap &kp LC(SPACE) &kp L>;
)

ZMK_MACRO(tmux_choose_window,
    wait-ms = <10>;
    tap-ms = <10>;
    bindings = <&macro_tap &kp LC(SPACE) &kp W>;
)

ZMK_MACRO(tmux_new_window,
    wait-ms = <10>;
    tap-ms = <10>;
    bindings = <&macro_tap &kp LC(SPACE) &kp C>;
)

ZMK_MACRO(tmux_zoom_pane,
    wait-ms = <10>;
    tap-ms = <10>;
    bindings = <&macro_tap &kp LC(SPACE) &kp Z>;
)

ZMK_MACRO(tmux_split_horizontal,
    wait-ms = <10>;
    tap-ms = <10>;
    bindings = <&macro_tap &kp LC(SPACE) &kp PIPE>;
)

ZMK_MACRO(tmux_split_vertical,
    wait-ms = <10>;
    tap-ms = <10>;
    bindings = <&macro_tap &kp LC(SPACE) &kp MINUS>;
)

ZMK_MACRO(tmux_break_pane,
    wait-ms = <10>;
    tap-ms = <10>;
    bindings = <&macro_tap &kp LC(SPACE) &kp EXCLAMATION>;
)

ZMK_MACRO(tmux_prev_pane,
    wait-ms = <10>;
    tap-ms = <10>;
    bindings = <&macro_tap &kp LC(SPACE) &kp A>;
)

ZMK_MACRO(tmux_join_previous_window,
    wait-ms = <10>;
    tap-ms = <10>;
    bindings = <&macro_tap &kp LC(SPACE) &kp LS(J)>;
)

ZMK_MACRO(tmux_copy_mode,
    wait-ms = <10>;
    tap-ms = <10>;
    bindings = <&macro_tap &kp LC(SPACE) &kp LBKT>;
)

ZMK_MACRO(tmux_paste_buffer,
    wait-ms = <10>;
    tap-ms = <10>;
    bindings = <&macro_tap &kp LC(SPACE) &kp RBKT>;
)

// Sticky shift + leader
ZMK_MACRO(leader_sft, bindings = <&sk LSHFT &leader>;)

// misc aliases
#define CANCEL      &kp K_CANCEL             // cancel caps-word and num-word

/* map Corne's extra keys */
#define CONFIG_WIRELESS 1
/* Keymap */



ZMK_LAYER(base,
//╭──────╮ ╭─────────────┬─────────────┬─────────────┬─────────────┬─────────────╮ ╭──────╮ ╭─────────────┬─────────────┬─────────────┬─────────────┬─────────────╮ ╭──────╮
    &kp TAB       &kp Q         &kp W         &kp E         &kp R         &kp T        X_MT     &kp Y       &kp U         &kp I         &kp O         &kp P          &kp BSPC
//├──────┤ ├─────────────┼─────────────┼─────────────┼─────────────┼─────────────┤ ├──────┤ ├─────────────┼─────────────┼─────────────┼─────────────┼─────────────┤ ├──────┤
    &kp LCTRL     &kp A          &kp S          &kp D          &kp F          &kp G      X_MM     &kp H     &kp J          &kp K          &kp L          &kp SQT      &kp LCTRL
//├──────┤ ├─────────────┼─────────────┼─────────────┼─────────────┼─────────────┤ ├──────┤ ├─────────────┼─────────────┼─────────────┼─────────────┼─────────────┤ ├──────┤
    &alt_caps     &kp Z         &kp X         &kp C         &kp V         &kp B       X_MB     &kp N      &kp M            &kp COMMA     &kp DOT       &kp FSLH     &kp LSHFT
//╰──────╯ ╰─────────────┼─────────────┴─────────────┼─────────────┼─────────────┤ ├──────┤ ├─────────────┼─────────────┼─────────────┴───────────────────────────╯ ╰──────╯
                                    &fst_lt LGUI ESC      &thumb_lt NAV SPACE &thumb_lt NAV2 DEL X_MH &thumb_lt FUN RET &thumb_lt NUM BSPC &shift_caps_word
//                                     ╰─────────────┴─────────────┴─────────────╯ ╰──────╯ ╰─────────────┴─────────────┴─────────────╯
)


ZMK_LAYER(num,


//╭──────╮ ╭─────  ────────┬────────────────┬───────────────┬─────────────┬─────────────╮ ╭──────╮ ╭─────────────┬─────────────┬─────────────┬─────────────┬─────────────╮ ╭──────╮
&kp GRAVE        &kp EXCLAMATION &kp AT_SIGN     &kp HASH        &kp DOLLAR    &kp PERCENT   X_MT           &kp CARET     &kp AMPERSAND &kp ASTERISK &kp LPAR      &kp RPAR        &kp G
//├──────┤ ├────  ─────────┼────────────────┼─────────────────┼─────────────┼─────────────┤ ├──────┤ ├─────────────┼─────────────┼─────────────┼─────────────┼─────────────┤ ├──────┤
&sk LCTRL     &kp N1          &kp N2           &kp N3          &kp N4        &kp N5        X_MM           &kp N6        &kp N7        &kp N8       &kp N9       &kp N0         &kp LCTRL
//├──────┤ ├───────────--──┼────────────────┼─────────────────┼─────────────┼─────────────┤ ├──────┤ ├─────────────┼─────────────┼─────────────┼─────────────┼─────────────┤ ├──────┤
&sk LALT            &sk LCTRL       &sk LALT       &sk LGUI       &sk LSHFT     &g_           X_MB           &kp CAPS     &sk LSHFT     &sk LGUI      &sk LALT      &sk LCTRL       &kp LSHFT
//├──────┤ ╰─────────────--┼────────────────┴─────────────────┼─────────────┼─────────────┤ ├──────┤ ├─────────────┼─────────────┼─────────────┴───────────────────────────╯ ├──────┤
                                                   &fst_lt LGUI ESC &kp SPACE &kp DOT X_MH &kp RET &kp BSPC &kp DEL
//╰──────╯                                           ╰─────────────┴─────────────╯ ╰──────╯ ╰─────────────┴─────────────╯                                           ╰──────╯
)

ZMK_LAYER(nav,

//╭──────╮ ╭─────  ────────┬────────────────┬───────────────┬─────────────┬─────────────╮ ╭──────╮ ╭─────────────┬─────────────┬─────────────┬─────────────┬─────────────╮ ╭──────╮
&kp LG(GRAVE) &tmux_last_window &tmux_prev_window &tmux_next_window &tmux_choose_window &tmux_new_window X_MT &tmux_join_previous_window &tmux_paste_buffer XXX                 XXX XXX &kp DEL
//├──────┤ ├────  ─────────┼────────────────┼─────────────────┼─────────────┼─────────────┤ ├──────┤ ├─────────────┼─────────────┼─────────────┼─────────────┼─────────────┤ ├──────┤
&sk LCTRL          &sk LCTRL       &sk LALT       &sk LGUI       &sk LSHFT     &tmux_copy_mode X_MM           &kp LEFT     &kp DOWN      &kp UP        &kp RIGHT     XXX           &kp LCTRL
//├──────┤ ├───────────--──┼────────────────┼─────────────────┼─────────────┼─────────────┤ ├──────┤ ├─────────────┼─────────────┼─────────────┼─────────────┼─────────────┤ ├──────┤
&sk LALT           &tmux_zoom_pane &tmux_split_horizontal &tmux_split_vertical &tmux_break_pane &tmux_prev_pane X_MB &kp HOME &kp PG_UP &kp PG_DN &kp END XXX &kp LSHFT
//├──────┤ ╰─────────────--┼────────────────┴─────────────────┼─────────────┼─────────────┤ ├──────┤ ├─────────────┼─────────────┼─────────────┴───────────────────────────╯ ├──────┤
                                                   &fst_lt LGUI ESC &kp SPACE &kp DOT X_MH &kp RET &kp BSPC &kp DEL
//╰──────╯                                           ╰─────────────┴─────────────┴─────────────╯          ╰─────────────┴─────────────┴─────────────╯
)

ZMK_LAYER(fun,
//╭──────╮ ╭─────────────┬─────────────┬─────────────┬─────────────┬─────────────╮ ╭──────╮ ╭─────────────┬─────────────┬─────────────┬─────────────┬─────────────╮ ╭──────╮
    &kp CAPS    &kp F1        &kp F2        &kp F3          &kp F4          &kp F5       X_MT     &kp F6       &kp F7          &kp F8          &kp F9          &kp F10         &kp ESC
//├──────┤ ├─────────────┼─────────────┼─────────────┼─────────────┼─────────────┤ ├──────┤ ├─────────────┼─────────────┼─────────────┼─────────────┼─────────────┤ ├──────┤
    &sk LCTRL   &kp F11       &kp F12       &kp C_PREVIOUS  &kp C_PLAY_PAUSE &kp C_NEXT   X_MM     &kp C_VOL_DN &kp C_MUTE     &kp C_VOL_UP   XXX           XXX           &kp LCTRL
//├──────┤ ├─────────────┼─────────────┼─────────────┼─────────────┼─────────────┤ ├──────┤ ├─────────────┼─────────────┼─────────────┼─────────────┼─────────────┤ ├──────┤
    &sk LALT    XXX             XXX             XXX             XXX             XXX             X_MB     _BT_SEL_KEYS_ &kp LSHFT
//├──────┤ ╰─────────────┼─────────────┴─────────────┼─────────────┼─────────────┤ ├──────┤ ├─────────────┼─────────────┼─────────────┴───────────────────────────╯ ├──────┤
                                                   &fst_lt LGUI ESC &kp SPACE &kp LALT X_MH &kp RET &kp BSPC &kp DEL
//╰──────╯                                           ╰─────────────┴─────────────╯ ╰──────╯ ╰─────────────┴─────────────╯
)

ZMK_LAYER(nav2,

//╭──────╮ ╭─────  ────────┬────────────────┬───────────────┬─────────────┬─────────────╮ ╭──────╮ ╭─────────────┬─────────────┬─────────────┬─────────────┬─────────────╮ ╭──────╮
&swapper    &kp LG(SPACE)    &kp LG(LS(LBKT)) &kp LG(LS(RBKT)) &kp LA(SPACE)    &kp ESC       X_MT     XXX           XXX          XXX          XXX          XXX          &kp ESC
//├──────┤ ├────  ─────────┼────────────────┼─────────────────┼─────────────┼─────────────┤ ├──────┤ ├─────────────┼─────────────┼─────────────┼─────────────┼─────────────┤ ├──────┤
&sk LCTRL   &kp BSPC         &kp LS(RET)     &kp LC(RET)     &kp RET         &kp DEL          X_MM     &kp LA(H)     &kp LA(J)     &kp LA(K)     &kp LA(L)     XXX           &kp LCTRL
//├──────┤ ├───────────--──┼────────────────┼─────────────────┼─────────────┼─────────────┼─────────────┤ ├──────┤
&sk LALT    &kp LC(LG(LS(N1))) &kp LC(LG(LS(N2))) &kp LC(LG(LS(N3))) &kp LC(LG(LS(N4))) &kp LC(LG(LS(N5))) X_MB     U_WH_L        U_WH_D       U_WH_U       U_WH_R       XXX           &kp LSHFT
//├──────┤ ╰─────────────--┼────────────────┴─────────────────┼─────────────┼─────────────┤ ├──────┤ ├─────────────┼─────────────┼─────────────┴───────────────────────────╯ ├──────┤
                                                   &fst_lt LGUI ESC &kp SPACE &kp LALT X_MH &mkp LCLK &mkp RCLK &mkp MCLK
//╰──────╯                                           ╰─────────────┴─────────────┴─────────────╯          ╰─────────────┴─────────────┴─────────────╯
)
